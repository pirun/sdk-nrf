## applications/nrf_desktop/src/modules/Kconfig.ble_gzp_selector
```kconfig
#
# Copyright (c) 2024 Nordic Semiconductor ASA
#
# SPDX-License-Identifier: LicenseRef-Nordic-5-Clause
#

menuconfig DESKTOP_BLE_GZP_SELECTOR_ENABLE
	bool "Module that controlls switching between BLE and Gazell using HW selector"
	depends on CAF_BLE_ADV
	depends on CAF_BLE_STATE
	depends on DESKTOP_GZP_ENABLE
	depends on DESKTOP_SELECTOR_HW_ENABLE
	select CAF_MODULE_SUSPEND_EVENTS
	help
	  The module controls switching between Bluetooth LE and Gazell using
	  a hardware selector.

if DESKTOP_BLE_GZP_SELECTOR_ENABLE

config DESKTOP_BLE_GZP_SELECTOR_ID
	int "ID of HW selector used to control switching between Bluetooth LE and Gazell"
	range 0 255
	default 0

config DESKTOP_BLE_GZP_SELECTOR_POS_BLE
	int "Selector position for BLE"
	range 0 255
	default 0

config DESKTOP_BLE_GZP_SELECTOR_POS_GZP
	int "Selector position for Gazell"
	range 0 255
	default 0

module = DESKTOP_BLE_GZP_SELECTOR
module-str = BLE/Gazell selector
source "subsys/logging/Kconfig.template.log_config"

endif # DESKTOP_BLE_GZP_SELECTOR_ENABLE
```

## applications/nrf_desktop/src/modules/Kconfig.gzp
```kconfig
#
# Copyright (c) 2024 Nordic Semiconductor
#
# SPDX-License-Identifier: LicenseRef-BSD-5-Clause-Nordic
#

menu "Gazell"

config DESKTOP_GZP_ENABLE
	bool "Enable Gazell module"
	depends on DESKTOP_ROLE_HID_PERIPHERAL
	select GAZELL
	select GZLL
	help
	  Enables Gazell module.

if DESKTOP_GZP_ENABLE

choice GAZELL_SWI
	default GAZELL_SWI1 if BT
	help
	  Update used software interrupt to avoid BLE interoperability issues.
endchoice

choice GAZELL_TIMER
	default GAZELL_TIMER2 if BT
	help
	  Update used timer to avoid BLE interoperability issues.
endchoice

config DESKTOP_GZP_MODULE_SUSPEND_EVENTS
	bool "Module suspend/resume request events support"
	depends on CAF_MODULE_SUSPEND_EVENTS
	default y

config DESKTOP_GZP_SUSPEND_ON_READY
	bool "Automatically suspend module right after initialization"
	depends on DESKTOP_GZP_MODULE_SUSPEND_EVENTS
	default y

choice GAZELL_PAIRING_ROLE
	default GAZELL_PAIRING_DEVICE if DESKTOP_ROLE_HID_PERIPHERAL
	help
	  Set proper Gazell pairing role.
endchoice

config DESKTOP_GZP_CRYPTO
	bool
	default y
	select GAZELL_PAIRING
	select GAZELL_PAIRING_CRYPT
	imply GAZELL_PAIRING_SETTINGS if SETTINGS
	select CRYPTO
	select CRYPTO_NRF_ECB
	select ENTROPY_GENERATOR
	help
	  Selects Kconfig options needed for Gazell pairing and encryption.

config DESKTOP_GZP_SUBSCRIBER_PRIORITY
	int "Gazell HID reports subscriber priority"
	default 1
	range 1 255
	help
	  The lower value means the lower priority in subscribtion to HID
	  reports. By default, Gazell uses the lowest possible priority.

config DESKTOP_GZP_LEGACY_HID_REPORT_MAP
	bool "Translate HID reports to nRFready Desktop 2 HID report map"
	imply GAZELL_PAIRING_USER_CONFIG_ENABLE
	default y
	help
	  Translate HID reports from the default report map used by nRF Desktop
	  to legacy HID report map that was used by nRFReady Desktop 2 reference
	  design. This option must be enabled for compatibility with nRFready
	  Desktop 2 Reference Design dongle.

if DESKTOP_GZP_LEGACY_HID_REPORT_MAP

config GAZELL_PAIRING_USER_CONFIG_FILE
	default "gzp_config_legacy_dongle.h"
	help
	  The file aligns Gazell configuration (pairing address and secret key)
	  with nRFReady Desktop 2 reference design. This file must be used for
	  compatibility with nRFready Desktop 2 Reference Design dongle.

endif # DESKTOP_GZP_LEGACY_HID_REPORT_MAP

config DESKTOP_GZP_PAIRING_DATA_ERASE_CLICK
	bool "Enable Gazell pairing data erase on long button click"
	help
	  The pairing data erase is triggered by a long button press. Gazell
	  pairing data is instantly removed.

if DESKTOP_GZP_PAIRING_DATA_ERASE_CLICK

config DESKTOP_GZP_PAIRING_DATA_ERASE_CLICK_KEY_ID
	hex "Key ID of button used to trigger pairing data erase"
	range 0x0000 0xffff
	default 0xffff

config DESKTOP_GZP_PAIRING_DATA_ERASE_CLICK_ON_BOOT_ONLY
	bool "Allow pairing data erase using button only right after boot"
	help
	  If the option is enabled, the pairing data erase on long button press
	  can only be triggered right after boot.

endif # DESKTOP_GZP_PAIRING_DATA_ERASE_CLICK

if !DESKTOP_GZP_PAIRING_DATA_ERASE_CLICK

config DESKTOP_GZP_PAIRING_DATA_ERASE_CLICK_KEY_ID
	hex
	range 0x0000 0xffff
	default 0xffff

endif # !DESKTOP_GZP_PAIRING_DATA_ERASE_CLICK

module = DESKTOP_GZP
module-str = Gazell
source "subsys/logging/Kconfig.template.log_config"

endif # DESKTOP_GZP_ENABLE

endmenu
```

## applications/serial_lte_modem/src/gpio/Kconfig
```kconfig
#
# Copyright (c) 2020 Nordic Semiconductor ASA
#
# SPDX-License-Identifier: LicenseRef-Nordic-5-Clause

config SLM_GPIO
	bool "GPIO support in SLM"
	default y
	select GPIO

config SLM_CUSTOMIZED_RS232
	bool "Enable customized RS232 pin"
	default SLM_CUSTOMIZED && SLM_GPIO

config SLM_RI_PIN
	int "Ring Indicator Pin"
	default 20

config SLM_RI_ON_DURATION
	int "Duration of the Ring Indicator Pin to be turned on in ms"
	default 1500

config SLM_RI_OFF_DURATION
	int "Duration of the Ring Indicator Pin to be turned off in ms"
	default 1500

config SLM_POST_RI_DURATION
	int "Duration of the wait after Ring Indicator to send URC"
	default 500

config SLM_DCD_PIN
	int "DCD Pin"
	default 26
```

## applications/serial_lte_modem/src/ui/Kconfig
```kconfig
#
# Copyright (c) 2021 Nordic Semiconductor ASA
#
# SPDX-License-Identifier: LicenseRef-BSD-5-Clause-Nordic

config SLM_UI
	bool "Enable SLM UI"
	depends on SLM_GPIO

config SLM_UI_DEBUG
	bool "Enable debug log of SLM UI"

config SLM_UI_LTE_STATE
	bool "LTE connection state pin option"
	default y
	help
	  This is an option to enable GPIO pin as LTE state indicator.

config SLM_UI_LTE_STATE_PIN
	int "LTE connection state pin"
	default 2
	help
	  Default GPIO pin as LTE state indicator.

config SLM_UI_DATA_ACTIVITY
	bool "Data pin option"
	default y
	help
	  This is an option to enable GPIO pin as data indicator.

config SLM_UI_DATA_ACTIVITY_PIN
	int "Data activity pin"
	default 3
	help
	  Default GPIO pin as data activity indicator.

config SLM_UI_LTE_SIGNAL
	bool "LTE signal strength pin option"
	default y
	help
	  This is an option to enable GPIO pin as LTE signal indicator.

config SLM_UI_LTE_SIGNAL_PIN
	int "LTE signal strength pin"
	default 4
	help
	  Default GPIO pin as LTE signal strength indicator.

config SLM_STATS_BATTERY_INTERVAL
	int "Interval to check battery level in ms"
	default 600000

config SLM_MOD_FLASH_PIN
	int "MOD_FLASH Pin"
	default 24
	help
	  Default GPIO pin as modem flash led.

config SLM_STATS_WATCHDOG
	bool "Watchdog support in SLM"
	select WATCHDOG

config SLM_STATS_WATCHDOG_TIMEOUT_MSEC
	int "Watchdog timeout in milliseconds"
	default 60000

config SLM_DIAG
	bool "Enable SLM diagnostic module"
	default SLM_CUSTOMIZED && SLM_UI
	select SLM_UI_DIAG

config SLM_UI_DIAG
	bool "SLM diagnostic pin option"
	help
	  This is an option to enable GPIO pin as SLM diagnostic indicator.

config SLM_UI_DIAG_PIN
	int "SLM diagnostic pin"
	default 5
	help
	  Default GPIO pin as SLM diagnostic indicator.
```

## boards/arm/nrf5340_audio_dk_nrf5340/nrf5340_audio_dk_nrf5340_cpuapp_defconfig
```kconfig
# SPDX-License-Identifier: Apache-2.0

CONFIG_SOC_SERIES_NRF53X=y
CONFIG_SOC_NRF5340_CPUAPP_QKAA=y
CONFIG_BOARD_NRF5340_AUDIO_DK_NRF5340_CPUAPP=y

CONFIG_BOARD_ENABLE_DCDC_APP=y
CONFIG_BOARD_ENABLE_DCDC_NET=y
CONFIG_BOARD_ENABLE_CPUNET=y

# Enable MPU
CONFIG_ARM_MPU=y

# Enable hardware stack protection
CONFIG_HW_STACK_PROTECTION=y

# Enable TrustZone-M
CONFIG_ARM_TRUSTZONE_M=y

# Enable GPIO
CONFIG_GPIO=y
# Enable uart driver
CONFIG_SERIAL=y
# enable console
CONFIG_CONSOLE=y
CONFIG_UART_CONSOLE=y
```

## subsys/gazell/Kconfig
```kconfig
#
# Copyright (c) 2021 Nordic Semiconductor ASA
#
# SPDX-License-Identifier: LicenseRef-Nordic-5-Clause
#

menuconfig GAZELL
	bool "Gazell"
	depends on GZLL && CLOCK_CONTROL_NRF
	select NRFX_PPI if HAS_HW_NRF_PPI
	select NRFX_DPPI if HAS_HW_NRF_DPPIC
	help
	  Enable Gazell functionality.

if GAZELL

config GAZELL_DYNAMIC_RADIO_INTERRUPT
	bool "Use direct dynamic interrupt for Radio IRQ"
	depends on DYNAMIC_DIRECT_INTERRUPTS
	help
	  This allows reassigning Radio IRQn when Gazell Link Layer is
	  uninitialized.

module = GAZELL
module-str = Gazell
source "subsys/logging/Kconfig.template.log_config"

config GAZELL_PAIRING
	bool "Gazell Pairing"
	help
	  Enable Gazell Pairing.

config GAZELL_GPIO_DEBUG
	bool "Gazell GPIO debug"
	help
	  Enable Gazell GPIO debug.

config GAZELL_DEBUG_FLY_PIN
	int "Gazell FLW debug pin"
	default 3 if SOC_SERIES_NRF54LX
	default 30 if SOC_SERIES_NRF52X
	default 7  if SOC_SERIES_NRF53X
	default 0
	help
	  The GPIO pin to use for Gazell debug flywheel.

config GAZELL_LCORE_DEBUG_IRQ_PIN
	int "Gazell LCORE debug IRQ pin"
	default 2 if SOC_SERIES_NRF54LX
	default 29 if SOC_SERIES_NRF52X
	default 25 if SOC_SERIES_NRF53X
	default 0
	help
	  The GPIO pin to use for Gazell debug LCORE IRQ.

config GAZELL_LCORE_DEBUG_PIN_1
	int "Gazell LCORE debug PIN 1"
	default 4 if SOC_SERIES_NRF54LX
	default 13 if SOC_SERIES_NRF52X
	default 28 if SOC_SERIES_NRF53X
	default 0
	help
	  The GPIO pin to use for Gazell debug LCORE PIN 1.

config GAZELL_LCORE_DEBUG_PIN_2
	int "Gazell LCORE debug PIN 2"
	default 40 if SOC_SERIES_NRF54LX
	default 14 if SOC_SERIES_NRF52X
	default 29 if SOC_SERIES_NRF53X
	default 0
	help
	  The GPIO pin to use for Gazell debug LCORE PIN 2.

config GAZELL_LCORE_DEBUG_PIN_3
	int "Gazell LCORE debug PIN 3"
	default 45 if SOC_SERIES_NRF54LX
	default 15 if SOC_SERIES_NRF52X
	default 30 if SOC_SERIES_NRF53X
	default 0
	help
	  The GPIO pin to use for Gazell debug LCORE PIN 3.

config GAZELL_LCORE_DEBUG_PIN_4
	int "Gazell LCORE debug PIN 4"
	default 46 if SOC_SERIES_NRF54LX
	default 16 if SOC_SERIES_NRF52X
	default 31 if SOC_SERIES_NRF53X
	default 0
	help
	  The GPIO pin to use for Gazell debug LCORE PIN 4.

config GAZELL_DEBUG_PIN
	int "Gazell general debug PIN"
	default 46 if SOC_SERIES_NRF54LX
	default 31 if SOC_SERIES_NRF52X
	default 31 if SOC_SERIES_NRF53X
	default 0
	help
	  The GPIO pin to use for Gazell general debug PIN.

if GAZELL_PAIRING

choice GAZELL_PAIRING_ROLE
	prompt "Gazell Pairing role"

config GAZELL_PAIRING_DEVICE
	bool "Device"

config GAZELL_PAIRING_HOST
	bool "Host"
	depends on ENTROPY_GENERATOR

endchoice # GAZELL_PAIRING_ROLE

config GAZELL_PAIRING_USER_CONFIG_ENABLE
	bool "Use application-specific Gazell Pairing configuration file"

if GAZELL_PAIRING_USER_CONFIG_ENABLE
config GAZELL_PAIRING_USER_CONFIG_FILE
	string "Gazell Pairing configuration file name"
	default "gzp_user_config.h"
	help
	  Modify the file name to use an application-specific Gazell Pairing configuration file.

endif # GAZELL_PAIRING_USER_CONFIG_ENABLE

if GAZELL_PAIRING_DEVICE

config GAZELL_PAIRING_DEVICE_MSGQ_LEN
	int "Gazell Pairing Device message queue length"
	range 1 20
	help
	  Specify the length of message queue in the device pairing module.
	  The module stores various events in the message queue. e.g. The
	  Gazell Link Layer callbacks are stored as events. The default of 1
	  works well for pairing and encypting data. Some applications
	  such as a computer mouse may send multiple packets at a time and
	  they will need a longer message queue.

endif # GAZELL_PAIRING_DEVICE

config GAZELL_PAIRING_CRYPT
	bool "Gazell Pairing encryption"
	imply ENTROPY_GENERATOR
	imply CRYPTO_NRF_ECB
	help
	  Enable Gazell Pairing encryption.

config GAZELL_PAIRING_SETTINGS
	bool "Gazell Pairing settings persistent storage"
	depends on SETTINGS
	help
	  Enable Gazell Pairing settings persistent storage.

endif # GAZELL_PAIRING

config GAZELL_ZERO_LATENCY_IRQS
	bool "Gazell zero-latency interrupts [EXPERIMENTAL]"
	depends on ZERO_LATENCY_IRQS
	select EXPERIMENTAL
	help
	  Enable zero-latency interrupt for Gazell's radio and timer IRQ so
	  that they will not be blocked by interrupt locking.

config GAZELL_HIGH_IRQ_PRIO
	int "Gazell high IRQ priority"
	range 0 0 if GAZELL_ZERO_LATENCY_IRQS
	range 0 5 if ZERO_LATENCY_IRQS
	range 0 6
	default 0
	help
	  The interrupt priority for Gazell's radio and timer IRQ. This value
	  shall be less than the Gazell's low IRQ priority value.

config GAZELL_LOW_IRQ_PRIO_MIN
	int
	default 0 if (GAZELL_ZERO_LATENCY_IRQS)
	default 1 if (GAZELL_HIGH_IRQ_PRIO = 0)
	default 2 if (GAZELL_HIGH_IRQ_PRIO = 1)
	default 3 if (GAZELL_HIGH_IRQ_PRIO = 2)
	default 4 if (GAZELL_HIGH_IRQ_PRIO = 3)
	default 5 if (GAZELL_HIGH_IRQ_PRIO = 4)
	default 6 if (GAZELL_HIGH_IRQ_PRIO = 5)
	default 7 if (GAZELL_HIGH_IRQ_PRIO = 6)

config GAZELL_LOW_IRQ_PRIO
	int "Gazell low IRQ priority"
	range GAZELL_LOW_IRQ_PRIO_MIN 6 if ZERO_LATENCY_IRQS
	range GAZELL_LOW_IRQ_PRIO_MIN 7
	default GAZELL_LOW_IRQ_PRIO_MIN
	help
	  The interrupt priority for Gazell's SWI IRQ. This value shall
	  be greater than the Gazell's high IRQ priority value.

choice GAZELL_TIMER
	default GAZELL_TIMER2
	default GAZELL_TIMER10 if $(dt_nodelabel_has_compat,timer10,$(DT_COMPAT_NORDIC_NRF_TIMER))
	prompt "Timer to use for the Gazell timer"

config GAZELL_TIMER0
	bool "TIMER0"
	depends on $(dt_nodelabel_has_compat,timer0,$(DT_COMPAT_NORDIC_NRF_TIMER))

config GAZELL_TIMER1
	bool "TIMER1"
	depends on $(dt_nodelabel_has_compat,timer1,$(DT_COMPAT_NORDIC_NRF_TIMER))

config GAZELL_TIMER2
	bool "TIMER2"
	depends on $(dt_nodelabel_has_compat,timer2,$(DT_COMPAT_NORDIC_NRF_TIMER))

config GAZELL_TIMER3
	bool "TIMER3"
	depends on $(dt_nodelabel_has_compat,timer3,$(DT_COMPAT_NORDIC_NRF_TIMER))

config GAZELL_TIMER4
	bool "TIMER4"
	depends on $(dt_nodelabel_has_compat,timer4,$(DT_COMPAT_NORDIC_NRF_TIMER))

config GAZELL_TIMER10
	bool "TIMER10"
	depends on $(dt_nodelabel_has_compat,timer10,$(DT_COMPAT_NORDIC_NRF_TIMER))
	select NRFX_TIMER10

config GAZELL_TIMER20
	bool "TIMER20"
	depends on $(dt_nodelabel_has_compat,timer20,$(DT_COMPAT_NORDIC_NRF_TIMER))
	select NRFX_TIMER20

config GAZELL_TIMER21
	bool "TIMER21"
	depends on $(dt_nodelabel_has_compat,timer21,$(DT_COMPAT_NORDIC_NRF_TIMER))

config GAZELL_TIMER22
	bool "TIMER22"
	depends on $(dt_nodelabel_has_compat,timer22,$(DT_COMPAT_NORDIC_NRF_TIMER))

config GAZELL_TIMER23
	bool "TIMER23"
	depends on $(dt_nodelabel_has_compat,timer23,$(DT_COMPAT_NORDIC_NRF_TIMER))

config GAZELL_TIMER24
	bool "TIMER24"
	depends on $(dt_nodelabel_has_compat,timer24,$(DT_COMPAT_NORDIC_NRF_TIMER))

endchoice

choice GAZELL_SWI
	default GAZELL_SWI0
	prompt "Software interrupt to use for Gazell event report"

config GAZELL_SWI0
	bool "SWI0"
	depends on HAS_HW_NRF_SWI0 || HAS_HW_NRF_EGU0 || SOC_SERIES_NRF54LX

config GAZELL_SWI1
	bool "SWI1"
	depends on HAS_HW_NRF_SWI1 || HAS_HW_NRF_EGU1 || SOC_SERIES_NRF54LX

config GAZELL_SWI2
	bool "SWI2"
	depends on HAS_HW_NRF_SWI2 || HAS_HW_NRF_EGU2 || SOC_SERIES_NRF54LX

config GAZELL_SWI3
	bool "SWI3"
	depends on HAS_HW_NRF_SWI3 || HAS_HW_NRF_EGU3 || SOC_SERIES_NRF54LX

config GAZELL_SWI4
	bool "SWI4"
	depends on HAS_HW_NRF_SWI4

config GAZELL_SWI5
	bool "SWI5"
	depends on HAS_HW_NRF_SWI5

endchoice

endif # GAZELL

module=GAZELL
module-str=GAZELL
source "${ZEPHYR_BASE}/subsys/logging/Kconfig.template.log_config"
```
