## CMakeLists.txt
```
#
# Copyright (c) 2021 Nordic Semiconductor ASA
#
# SPDX-License-Identifier: Apache-2.0
#

cmake_minimum_required(VERSION 3.20.0)

find_package(Zephyr REQUIRED HINTS $ENV{ZEPHYR_BASE})

get_target_property(TFM_BINARY_DIR tfm TFM_BINARY_DIR)
configure_file(
  ${CMAKE_CURRENT_LIST_DIR}/EXAMPLE/tfm_manifest_list.yaml.in
  ${CMAKE_CURRENT_BINARY_DIR}/EXAMPLE/tfm_manifest_list.yaml
)

set_property(TARGET zephyr_property_target
  APPEND PROPERTY TFM_CMAKE_OPTIONS
  -DTFM_EXTRA_MANIFEST_LIST_FILES=${CMAKE_CURRENT_BINARY_DIR}/EXAMPLE/tfm_manifest_list.yaml
  -DTFM_EXTRA_PARTITION_PATHS=${CMAKE_CURRENT_LIST_DIR}/EXAMPLE
  -DTFM_PARTITION_EXAMPLE_OOT=ON
)
set_property(TARGET zephyr_property_target
  APPEND PROPERTY TFM_CMAKE_OPTIONS
  -DCMAKE_BUILD_TYPE=debug
  -DTFM_SPM_LOG_LEVEL=TFM_SPM_LOG_LEVEL_DEBUG
  -DTFM_PARTITION_LOG_LEVEL=TFM_PARTITION_LOG_LEVEL_DEBUG
  )

project(tfm_secure_partition_example_out_of_tree)

target_sources(app PRIVATE 
  src/main.c
  ns_api/tfm_example_api.c)

target_include_directories(app PRIVATE
  ${ZEPHYR_TRUSTED_FIRMWARE_M_MODULE_DIR}/trusted-firmware-m/interface/include
  ns_api

)
zephyr_link_libraries(
 -Wl,--undefined=psa_framework_version
 -Wl,--undefined=example_main
 -Wl,--undefined=rot_A_by_handle
 -Wl,--undefined=rot_A
 -Wl,--undefined=example_signal_handle
 -Wl,--undefined=rot_B_by_handle_ipc
 -Wl,--undefined=rot_a_input_output_req
 -Wl,--undefined=rot_a_operation
 -Wl,--undefined=LOG_DBGFMT
 -Wl,--undefined=LOG_ERRFMT
 -Wl,--undefined=LOG_INFFMT

 )
 

 target_include_directories(app PRIVATE
  ${ZEPHYR_TRUSTED_FIRMWARE_M_MODULE_DIR}/interface/include
)

target_compile_definitions(app
    PRIVATE TFM_PARTITION_EXAMPLE
)
```

## sample.yaml
```
sample:
    description: This app provides an example of using TF-M custom secure partition on the secure
        side, with Zephyr on the NS side, using IPC or LIBrary.The source code of Secure partition
        located with application.
    name: TF-M EXAMPLE SECURE PARTITION client
tests:
    sample.tfm_secure_partition_example:
        tags: introduction tfm
        platform_allow: nrf9160dk_nrf9160_ns
        harness: console
        harness_config:
          type: multi_line
          regex:
            - "The version of the PSA Framework API is"
            - "The minor version is"
            - "Connect success!"
            - "TF-M IPC on .*"
```

## prj.conf
```kconfig
CONFIG_BUILD_WITH_TFM=y
#CONFIG_TFM_IPC=y
CONFIG_REBOOT=y

# The Zephyr CMSIS emulation assumes that ticks are ms, currently
CONFIG_SYS_CLOCK_TICKS_PER_SEC=1000

CONFIG_MAIN_STACK_SIZE=4096
CONFIG_HEAP_MEM_POOL_SIZE=4096
```

## src/main.c
```c
/*
 * Copyright (c) 2021 Nordic Semiconductor ASA.
 *
 * SPDX-License-Identifier: LicenseRef-Nordic-5-Clause
 */

#include <zephyr.h>
#include <sys/printk.h>
#include <power/reboot.h>

#include "tfm_api.h"
#include "tfm_ns_interface.h"
#include "tfm_example_api.h"
#include "psa/crypto.h"
#include <string.h>

#ifdef TFM_PSA_API
    #include "psa_manifest/sid.h"
#endif

#define I_LIKE_REBOOT
#define ROT_A_TEST_DATA_COUNT 2
const uint8_t GREETING_A_1[] = "str1";
const uint8_t GREETING_A_2[] = "this call is from non-secure happy world to secure world RoT_A";
//this call is from non-secure happy world to secure world RoT_B
const uint8_t GREETING_B[] = {0x74,0x68,0x69,0x73,0x20,0x63,0x61,0x6c,0x6c,0x20,0x69,0x73,0x20,0x66,0x72,0x6f,\
                0x6d,0x20,0x6e,0x6f,0x6e,0x2d,0x73,0x65,0x63,0x75,0x72,0x65,0x20,0x68,0x61,0x70,0x70,\
                0x79,0x20,0x77,0x6f,0x72,0x6c,0x64,0x20,0x74,0x6f,0x20,0x73,0x65,0x63,0x75,0x72,0x65,\
                0x20,0x77,0x6f,0x72,0x6c,0x64,0x20,0x52,0x6f,0x54,0x5f,0x42};
size_t GREETING_B_SIZE = sizeof(GREETING_B)/sizeof(GREETING_B[0]);
const uint8_t GREETING_C[] = "this call is from non-secure happy world to secure world RoT_C";

static void print_hex_number(uint8_t *num, size_t len)
{
	printk("0x");
	for (int i = 0; i < len; i++) {
		printk("%02x", num[i]);
	}
	printk("\n");
}
//IPC MODEL
#if defined(TFM_PSA_API)
static void tfm_example_ipc_test_rot_a(void)
{
    char str3[128], str4[128];
    struct psa_invec invecs[ROT_A_TEST_DATA_COUNT] = {{GREETING_A_1, sizeof(GREETING_A_1)},
                                  {GREETING_A_2, sizeof(GREETING_A_2)}};
    struct psa_outvec outvecs[ROT_A_TEST_DATA_COUNT] = {{str3, sizeof(str3)},
                                    {str4, sizeof(str4)}};
    psa_handle_t handle;
    psa_status_t status;
    uint32_t version;

    version = psa_version(ROT_A_INPUT_OUTPUT_SID);
    printk("TFM service ROT_A_INPUT_OUTPUT 0x%x support version is %d.\r\n", ROT_A_INPUT_OUTPUT_SID, version);
    handle = psa_connect(ROT_A_INPUT_OUTPUT_SID, ROT_A_INPUT_OUTPUT_VERSION);
    if (handle > 0) {
        printk("connected\r\n");
    } else {
		printk("The RoT Service has refused the connection!\n");
		return;
	}
    status = psa_call(handle, PSA_IPC_CALL, invecs, ROT_A_TEST_DATA_COUNT, outvecs, ROT_A_TEST_DATA_COUNT);
    if (status >= 0) {
        printk("psa_call ROT_A is successful!\r\n");
    } else {
        printk("psa_call ROT_A is failed!\r\n");
        return;
    }
    for(uint8_t idx = 0; idx < ROT_A_TEST_DATA_COUNT; idx++) {
        printk("outvec%d is: %s\r\n", idx+1, (char *)outvecs[idx].base);        
    }
        
    psa_close(handle);
    printk("TEST_PASSED tfm_example_ipc_test_rot_a\n");
}
static void tfm_example_ipc_test_rot_b(void)
{
	char str2[DIGEST_SIZE], computed_hash[DIGEST_SIZE];
	struct psa_invec invecs[1] = {
        {.base = GREETING_B, .len = GREETING_B_SIZE}
    };
	struct psa_outvec outvecs[1] = {
        {.base = str2, .len = DIGEST_SIZE}
    };
    psa_handle_t handle;
    psa_status_t status;
    uint32_t version;
    size_t hash_length;

    version = psa_version(ROT_B_CRYPTO_HASH_SID);
    printk("TFM service ROT_B_CRYPTO_RAND_SID 0x%x support version is %d.\r\n", ROT_B_CRYPTO_HASH_SID, version);
    handle = psa_connect(ROT_B_CRYPTO_HASH_SID, ROT_B_CRYPTO_HASH_VERSION);
    if (handle > 0) {
        printk("connected\r\n");
    } else {
		printk("The RoT Service has refused the connection!\n");
		return;
	}    
    status = psa_call(handle, PSA_IPC_CALL, invecs, 1, outvecs, 1);
    if (status >= 0) {
        printk("psa_call ROT_B is successful!\r\n");
    } else {
        printk("psa_call ROT_B is failed!\r\n");
        return;
    }
    printk("rot_b output hash is:\n");
	print_hex_number(outvecs[0].base, outvecs[0].len);
    psa_close(handle);
    status = psa_hash_compute(PSA_ALG_SHA_256,
                        GREETING_B,
                        sizeof(GREETING_B),
                        computed_hash,
                        DIGEST_SIZE,
                        &hash_length);
    printk("psa_hash_compute hash is:\n");
	print_hex_number(computed_hash, DIGEST_SIZE);
    if(memcmp(outvecs[0].base, computed_hash, DIGEST_SIZE) == 0) {
        printk("TEST_PASSED tfm_example_ipc_test_rot_b\n");
    } else {
        printk("TEST_FAILED tfm_example_ipc_test_rot_b\n");
    }    
}

static void tfm_example_ipc_test_rot_c(void)
{
	char str2[DIGEST_SIZE];
	struct psa_outvec outvecs[1] = {
        {.base = str2, .len = DIGEST_SIZE}
    };
    psa_handle_t handle;
    psa_status_t status;
    uint32_t version;

    version = psa_version(ROT_C_CRYPTO_RAND_SID);
    printk("TFM service ROT_C_CRYPTO_RAND_SID 0x%x support version is %d.\r\n", ROT_C_CRYPTO_RAND_SID, version);
    handle = psa_connect(ROT_C_CRYPTO_RAND_SID, ROT_C_CRYPTO_RAND_VERSION);
    if (handle > 0) {
        printk("connected\r\n");
    } else {
		printk("The RoT Service has refused the connection!\n");
		return;
	}    
    status = psa_call(handle, PSA_IPC_CALL, NULL, 0, outvecs, 1);
    if (status >= 0) {
        printk("psa_call ROT_C is successful!\r\n");
    } else {
        printk("psa_call ROT_C is failed!\r\n");
        return;
    }

    printk("rot_c output random number is:\n");
	print_hex_number(outvecs[0].base, outvecs[0].len);
    psa_close(handle);
    printk("TEST_PASSED tfm_example_ipc_test_rot_c\n");
}
#else
static psa_status_t tfm_example_lib_test_rot_a(void)
{
    psa_status_t status ;    
    uint8_t str3[128], str4[128];
    const uint8_t *in_data[ROT_A_TEST_DATA_COUNT] = {GREETING_A_1, GREETING_A_2};
    uint8_t *out_data[ROT_A_TEST_DATA_COUNT] = {str3, str4};
    size_t in_data_len[ROT_A_TEST_DATA_COUNT] = {sizeof(GREETING_A_1), sizeof(GREETING_A_2)};
    size_t out_data_len[ROT_A_TEST_DATA_COUNT] = {sizeof(str3), sizeof(str4)};

    printk("%s\n",__func__);
    status = rot_a_input_output(in_data, in_data_len,
                        out_data, out_data_len,
                        ROT_A_TEST_DATA_COUNT);
    
    for(uint8_t idx = 0; idx < ROT_A_TEST_DATA_COUNT; idx++) {
        printk("outvec%d is: %s\r\n", idx+1, out_data[idx]);        
    }
    if(status == PSA_SUCCESS){
        printk("TEST_PASSED tfm_example_lib_test_rot_a\n");
    }
    return status;
}

static psa_status_t tfm_example_lib_test_rot_b(void)
{
    psa_status_t status ;
	uint8_t str2[DIGEST_SIZE],	computed_hash[DIGEST_SIZE];
    size_t hash_length;

    printk("%s\n",__func__);
    status = rot_b_crypto_hash(GREETING_B, GREETING_B_SIZE, str2);
    if(status == PSA_SUCCESS) {
        print_hex_number(str2, DIGEST_SIZE);
    }
    status = psa_hash_compute(PSA_ALG_SHA_256,
                        GREETING_B,
                        sizeof(GREETING_B),
                        computed_hash,
                        DIGEST_SIZE,
                        &hash_length);
    printk("psa_hash_compute hash is:\n");
	print_hex_number(computed_hash, DIGEST_SIZE);
    if(memcmp(str2, computed_hash, DIGEST_SIZE) == 0) {
        printk("TEST_PASSED tfm_example_ipc_test_rot_b\n");
    } else {
        printk("TEST_FAILED tfm_example_ipc_test_rot_b\n");
    }    

    return status;
}
static psa_status_t tfm_example_lib_test_rot_c(void)
{
    psa_status_t status ;
	char str2[DIGEST_SIZE];    

    printk("%s\n",__func__);
    status = rot_c_crypto_rand(str2);
    if(status == PSA_SUCCESS) {
        print_hex_number(str2, DIGEST_SIZE);
    }
    if(status == PSA_SUCCESS) {
        printk("TEST_PASSED tfm_example_lib_test_rot_c\n");
    }
    return status;
}

#endif
void main(void)
{
	psa_crypto_init();
#ifdef TFM_PSA_API
	printk("TF-M IPC on %s\n", CONFIG_BOARD);
	tfm_example_ipc_test_rot_a();
	tfm_example_ipc_test_rot_b();
	tfm_example_ipc_test_rot_c();
#else
	printk("TF-M LIB on %s\n", CONFIG_BOARD);
    tfm_example_lib_test_rot_a();
    tfm_example_lib_test_rot_b();
    tfm_example_lib_test_rot_c();
#endif

#if defined(I_LIKE_REBOOT)
    uint8_t count = 5;
	printk("Wait 5 seconds before reset\n");
    while(count) {
        printk("%d\n", count--);
        k_sleep(K_MSEC(1000));
    }	
	sys_reboot(0);
#endif	
}
```
